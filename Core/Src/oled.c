#include "oled.h"
#include <string.h>

/* OLED 使用 PC0/PC1 软件 I2C，7 位地址为 0x3C。 */
#define OLED_SCL_GPIO_PORT      GPIOC
#define OLED_SCL_GPIO_PIN       GPIO_PIN_0
#define OLED_SDA_GPIO_PORT      GPIOC
#define OLED_SDA_GPIO_PIN       GPIO_PIN_1
#define OLED_I2C_WRITE_ADDRESS  0x78U

static uint8_t oled_buffer[1024];

/* 标准 5x7 ASCII 字库，只占约 480 字节，方便显示英文和数字。 */
static const uint8_t font5x7[][5] = {
{0,0,0,0,0},{0,0,0x5F,0,0},{0,7,0,7,0},{0x14,0x7F,0x14,0x7F,0x14},{0x24,0x2A,0x7F,0x2A,0x12},{0x23,0x13,8,0x64,0x62},{0x36,0x49,0x55,0x22,0x50},{0,5,3,0,0},{0,0x1C,0x22,0x41,0},{0,0x41,0x22,0x1C,0},{0x14,8,0x3E,8,0x14},{8,8,0x3E,8,8},{0,0x50,0x30,0,0},{8,8,8,8,8},{0,0x60,0x60,0,0},{0x20,0x10,8,4,2},
{0x3E,0x51,0x49,0x45,0x3E},{0,0x42,0x7F,0x40,0},{0x42,0x61,0x51,0x49,0x46},{0x21,0x41,0x45,0x4B,0x31},{0x18,0x14,0x12,0x7F,0x10},{0x27,0x45,0x45,0x45,0x39},{0x3C,0x4A,0x49,0x49,0x30},{1,0x71,9,5,3},{0x36,0x49,0x49,0x49,0x36},{6,0x49,0x49,0x29,0x1E},{0,0x36,0x36,0,0},{0,0x56,0x36,0,0},{8,0x14,0x22,0x41,0},{0x14,0x14,0x14,0x14,0x14},{0,0x41,0x22,0x14,8},{2,1,0x51,9,6},
{0x32,0x49,0x79,0x41,0x3E},{0x7E,0x11,0x11,0x11,0x7E},{0x7F,0x49,0x49,0x49,0x36},{0x3E,0x41,0x41,0x41,0x22},{0x7F,0x41,0x41,0x22,0x1C},{0x7F,0x49,0x49,0x49,0x41},{0x7F,9,9,9,1},{0x3E,0x41,0x49,0x49,0x7A},{0x7F,8,8,8,0x7F},{0,0x41,0x7F,0x41,0},{0x20,0x40,0x41,0x3F,1},{0x7F,8,0x14,0x22,0x41},{0x7F,0x40,0x40,0x40,0x40},{0x7F,2,0x0C,2,0x7F},{0x7F,4,8,0x10,0x7F},{0x3E,0x41,0x41,0x41,0x3E},
{0x7F,9,9,9,6},{0x3E,0x41,0x51,0x21,0x5E},{0x7F,9,0x19,0x29,0x46},{0x46,0x49,0x49,0x49,0x31},{1,1,0x7F,1,1},{0x3F,0x40,0x40,0x40,0x3F},{0x1F,0x20,0x40,0x20,0x1F},{0x3F,0x40,0x38,0x40,0x3F},{0x63,0x14,8,0x14,0x63},{7,8,0x70,8,7},{0x61,0x51,0x49,0x45,0x43},{0,0x7F,0x41,0x41,0},{2,4,8,0x10,0x20},{0,0x41,0x41,0x7F,0},{4,2,1,2,4},{0x40,0x40,0x40,0x40,0x40},
{0,1,2,4,0},{0x20,0x54,0x54,0x54,0x78},{0x7F,0x48,0x44,0x44,0x38},{0x38,0x44,0x44,0x44,0x20},{0x38,0x44,0x44,0x48,0x7F},{0x38,0x54,0x54,0x54,0x18},{8,0x7E,9,1,2},{0x0C,0x52,0x52,0x52,0x3E},{0x7F,8,4,4,0x78},{0,0x44,0x7D,0x40,0},{0x20,0x40,0x44,0x3D,0},{0x7F,0x10,0x28,0x44,0},{0,0x41,0x7F,0x40,0},{0x7C,4,0x18,4,0x78},{0x7C,8,4,4,0x78},{0x38,0x44,0x44,0x44,0x38},
{0x7C,0x14,0x14,0x14,8},{8,0x14,0x14,0x18,0x7C},{0x7C,8,4,4,8},{0x48,0x54,0x54,0x54,0x20},{4,0x3F,0x44,0x40,0x20},{0x3C,0x40,0x40,0x20,0x7C},{0x1C,0x20,0x40,0x20,0x1C},{0x3C,0x40,0x30,0x40,0x3C},{0x44,0x28,0x10,0x28,0x44},{0x0C,0x50,0x50,0x50,0x3C},{0x44,0x64,0x54,0x4C,0x44},{0,8,0x36,0x41,0},{0,0,0x7F,0,0},{0,0x41,0x36,8,0},{0x10,8,8,0x10,8}
};

/* 项目专用 16x16 中文字库，每行前 16 字节是上半部分，后 16 字节是下半部分。 */
static const uint8_t font16x16[OLED_HZ_COUNT][32] = {
  {0x40,0x40,0x42,0x44,0x58,0xC0,0x40,0x7F,0x40,0xC0,0x50,0x48,0x46,0x40,0x40,0x00,0x80,0x80,0x40,0x20,0x18,0x07,0x00,0x00,0x00,0x3F,0x40,0x40,0x40,0x40,0x78,0x00},
  {0x20,0x30,0xAC,0x63,0x20,0x18,0x80,0x90,0x90,0xFF,0x90,0x49,0x4A,0x48,0x40,0x00,0x22,0x67,0x22,0x12,0x12,0x12,0x40,0x40,0x20,0x13,0x0C,0x14,0x22,0x41,0xF8,0x00},
  {0x10,0x60,0x02,0x8C,0x00,0x00,0xFE,0x92,0x92,0x92,0x92,0x92,0xFE,0x00,0x00,0x00,0x04,0x04,0x7E,0x01,0x40,0x7E,0x42,0x42,0x7E,0x42,0x7E,0x42,0x42,0x7E,0x40,0x00},
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  {0x48,0x4A,0xFA,0x0A,0xFE,0x09,0xF9,0x49,0xA8,0x00,0x00,0xF0,0x00,0x00,0xFF,0x00,0x22,0x11,0x0B,0x04,0xFF,0x04,0x09,0x12,0x23,0x00,0x00,0x0F,0x40,0x80,0x7F,0x00}
};

/* OLED 使用原理图 PC0/PC1 软件 I2C。 */
static void OLED_I2cDelay(void)
{
  volatile uint8_t i;
  for (i = 0; i < 30U; i++) __NOP();
}

static void OLED_Scl(GPIO_PinState state)
{
  HAL_GPIO_WritePin(OLED_SCL_GPIO_PORT, OLED_SCL_GPIO_PIN, state);
}

static void OLED_Sda(GPIO_PinState state)
{
  HAL_GPIO_WritePin(OLED_SDA_GPIO_PORT, OLED_SDA_GPIO_PIN, state);
}

static void OLED_I2cStart(void)
{
  OLED_Sda(GPIO_PIN_SET);
  OLED_Scl(GPIO_PIN_SET);
  OLED_I2cDelay();
  OLED_Sda(GPIO_PIN_RESET);
  OLED_I2cDelay();
  OLED_Scl(GPIO_PIN_RESET);
}

static void OLED_I2cStop(void)
{
  OLED_Sda(GPIO_PIN_RESET);
  OLED_Scl(GPIO_PIN_SET);
  OLED_I2cDelay();
  OLED_Sda(GPIO_PIN_SET);
  OLED_I2cDelay();
}

/* MCU 单独复位时 OLED 可能仍停在一次未结束的通信中，用 9 个时钟释放总线。 */
static void OLED_I2cRecover(void)
{
  uint8_t count;
  OLED_Sda(GPIO_PIN_SET);
  for (count = 0; count < 9U; count++)
  {
    OLED_Scl(GPIO_PIN_RESET);
    OLED_I2cDelay();
    OLED_Scl(GPIO_PIN_SET);
    OLED_I2cDelay();
  }
  OLED_I2cStop();
}

static void OLED_I2cWriteByte(uint8_t value)
{
  uint8_t bit;
  for (bit = 0; bit < 8U; bit++)
  {
    OLED_Sda((value & 0x80U) ? GPIO_PIN_SET : GPIO_PIN_RESET);
    OLED_I2cDelay();
    OLED_Scl(GPIO_PIN_SET);
    OLED_I2cDelay();
    OLED_Scl(GPIO_PIN_RESET);
    value <<= 1;
  }
  /* 第九个时钟用于从机 ACK；OLED 写入时不需要读取 ACK。 */
  OLED_Sda(GPIO_PIN_SET);
  OLED_Scl(GPIO_PIN_SET);
  OLED_I2cDelay();
  OLED_Scl(GPIO_PIN_RESET);
}

static void OLED_WriteCommand(uint8_t command)
{
  OLED_I2cStart();
  OLED_I2cWriteByte(OLED_I2C_WRITE_ADDRESS);
  OLED_I2cWriteByte(0x00U);
  OLED_I2cWriteByte(command);
  OLED_I2cStop();
}

/* 初始化常见 128x64、I2C 接口的 SSD1306 OLED。 */
void OLED_Init(void)
{
  GPIO_InitTypeDef gpio = {0};
  __HAL_RCC_GPIOC_CLK_ENABLE();
  gpio.Pin = OLED_SCL_GPIO_PIN | OLED_SDA_GPIO_PIN;
  gpio.Mode = GPIO_MODE_OUTPUT_OD;
  gpio.Pull = GPIO_PULLUP;
  gpio.Speed = GPIO_SPEED_FREQ_HIGH;
  HAL_GPIO_Init(OLED_SCL_GPIO_PORT, &gpio);
  OLED_Scl(GPIO_PIN_SET);
  OLED_Sda(GPIO_PIN_SET);
  HAL_Delay(100);
  OLED_I2cRecover();
  HAL_Delay(10);
  OLED_WriteCommand(0xAE); OLED_WriteCommand(0x20); OLED_WriteCommand(0x00);
  OLED_WriteCommand(0xB0); OLED_WriteCommand(0xC8); OLED_WriteCommand(0x00);
  OLED_WriteCommand(0x10); OLED_WriteCommand(0x40); OLED_WriteCommand(0x81);
  OLED_WriteCommand(0x7F); OLED_WriteCommand(0xA1); OLED_WriteCommand(0xA6);
  OLED_WriteCommand(0xA8); OLED_WriteCommand(0x3F); OLED_WriteCommand(0xA4);
  OLED_WriteCommand(0xD3); OLED_WriteCommand(0x00); OLED_WriteCommand(0xD5);
  OLED_WriteCommand(0x80); OLED_WriteCommand(0xD9); OLED_WriteCommand(0xF1);
  OLED_WriteCommand(0xDA); OLED_WriteCommand(0x12); OLED_WriteCommand(0xDB);
  OLED_WriteCommand(0x40); OLED_WriteCommand(0x8D); OLED_WriteCommand(0x14);
  OLED_WriteCommand(0xAF);
  HAL_Delay(20);
  OLED_Clear();
  OLED_Refresh();
}

void OLED_Clear(void)
{
  memset(oled_buffer, 0, sizeof(oled_buffer));
}

/* 在显存中显示一行 5x7 ASCII 字符，page 范围为 0~7。 */
void OLED_ShowString(uint8_t x, uint8_t page, const char *text)
{
  uint8_t column;
  uint8_t character;
  while (*text != '\0' && x < 122U && page < 8U)
  {
    character = (uint8_t)*text++;
    if (character < 32U || character > 126U) character = '?';
    for (column = 0; column < 5U; column++)
      oled_buffer[page * 128U + x + column] = font5x7[character - 32U][column];
    oled_buffer[page * 128U + x + 5U] = 0;
    x += 6U;
  }
}

/*
 * 把原来的 5x7 字符纵向放大为 5x14，并放入 16 像素高的区域。
 * 主要用于数值和符号，使它们与 16x16 汉字上下对齐。
 */
void OLED_ShowString16(uint8_t x, uint8_t page, const char *text)
{
  uint8_t character;
  uint8_t column;
  uint8_t source_row;
  uint8_t target_row;
  uint8_t upper;
  uint8_t lower;

  while (*text != '\0' && x <= 121U && page <= 6U)
  {
    character = (uint8_t)*text++;
    if (character < 32U || character > 126U) character = '?';

    for (column = 0; column < 5U; column++)
    {
      upper = 0U;
      lower = 0U;
      for (source_row = 0; source_row < 7U; source_row++)
      {
        if ((font5x7[character - 32U][column] & (1U << source_row)) != 0U)
        {
          target_row = source_row * 2U;
          if (target_row < 8U)
          {
            upper |= (uint8_t)(1U << target_row);
            upper |= (uint8_t)(1U << (target_row + 1U));
          }
          else
          {
            target_row -= 8U;
            lower |= (uint8_t)(1U << target_row);
            lower |= (uint8_t)(1U << (target_row + 1U));
          }
        }
      }
      oled_buffer[page * 128U + x + column] = upper;
      oled_buffer[(page + 1U) * 128U + x + column] = lower;
    }
    oled_buffer[page * 128U + x + 5U] = 0U;
    oled_buffer[(page + 1U) * 128U + x + 5U] = 0U;
    oled_buffer[page * 128U + x + 6U] = 0U;
    oled_buffer[(page + 1U) * 128U + x + 6U] = 0U;
    x += 7U;
  }
}

/* 在显存中显示一个 16x16 汉字，page 只能使用 0、2、4、6。 */
void OLED_ShowChinese(uint8_t x, uint8_t page, OLED_Chinese_t chinese)
{
  uint8_t column;
  if (x > 112U || page > 6U || chinese >= OLED_HZ_COUNT) return;

  for (column = 0; column < 16U; column++)
  {
    oled_buffer[page * 128U + x + column] = font16x16[chinese][column];
    oled_buffer[(page + 1U) * 128U + x + column] = font16x16[chinese][column + 16U];
  }
}

/* 把 1024 字节显存按页发送给 OLED。 */
void OLED_Refresh(void)
{
  uint8_t page;
  uint8_t column;
  for (page = 0; page < 8U; page++)
  {
    OLED_WriteCommand((uint8_t)(0xB0U + page));
    OLED_WriteCommand(0x00);
    OLED_WriteCommand(0x10);
    OLED_I2cStart();
    OLED_I2cWriteByte(OLED_I2C_WRITE_ADDRESS);
    OLED_I2cWriteByte(0x40U);
    for (column = 0; column < 128U; column++)
      OLED_I2cWriteByte(oled_buffer[page * 128U + column]);
    OLED_I2cStop();
  }
}
